/*****************************************************************************
*
*  WiFiSwitch.ino - Remote switch with http server interface. 
*
*  Copyright (c) 2014, FunMaker Ltd.
*
*
*  This library porting from CC3000 host driver, which works with 
*  Spider_L3S WiFi module.
*
*  Spider_L3S wifi module is developed by Funmaker, we are actively 
*  involved in Taiwan maker community, and we aims to support makers 
*  to make more creative projects. 
*
*  You can support us, by buying this wifi module, and we are looking
*  forward to see your awesome projects!
*
*
*  Redistribution and use in source and binary forms, with or without
*  modification, are permitted provided that the following conditions
*  are met:
*
*    Redistributions of source code must retain the above copyright
*    notice, this list of conditions and the following disclaimer.
*
*    Redistributions in binary form must reproduce the above copyright
*    notice, this list of conditions and the following disclaimer in the
*    documentation and/or other materials provided with the   
*    distribution.
*
*    Neither the name of Texas Instruments Incorporated nor the names of
*    its contributors may be used to endorse or promote products derived
*    from this software without specific prior written permission.
*
*  THIS SOFTWARE IS PROVIDED BY THE COPYRIGHT HOLDERS AND CONTRIBUTORS 
*  "AS IS" AND ANY EXPRESS OR IMPLIED WARRANTIES, INCLUDING, BUT NOT 
*  LIMITED TO, THE IMPLIED WARRANTIES OF MERCHANTABILITY AND FITNESS FOR
*  A PARTICULAR PURPOSE ARE DISCLAIMED. IN NO EVENT SHALL THE COPYRIGHT 
*  OWNER OR CONTRIBUTORS BE LIABLE FOR ANY DIRECT, INDIRECT, INCIDENTAL, 
*  SPECIAL, EXEMPLARY, OR CONSEQUENTIAL DAMAGES (INCLUDING, BUT NOT 
*  LIMITED TO, PROCUREMENT OF SUBSTITUTE GOODS OR SERVICES; LOSS OF USE,
*  DATA, OR PROFITS; OR BUSINESS INTERRUPTION) HOWEVER CAUSED AND ON ANY
*  THEORY OF LIABILITY, WHETHER IN CONTRACT, STRICT LIABILITY, OR TORT 
*  (INCLUDING NEGLIGENCE OR OTHERWISE) ARISING IN ANY WAY OUT OF THE USE 
*  OF THIS SOFTWARE, EVEN IF ADVISED OF THE POSSIBILITY OF SUCH DAMAGE.
*
*****************************************************************************/

#include <Arduino.h>
#include <SPI.h>
#include "EEPROM.h"
#include "Wire.h"

#include <stdio.h>
#include <string.h>

#include "Spider_L3.h"
#include "WebClient.h"
#include "WebServer.h"
#include "utility/twi.h"

static unsigned char PROGMEM index_data[923]=
{
    0x3C,0x21,0x44,0x4F,0x43,0x54,0x59,0x50,0x45,0x20,0x68,
    0x74,0x6D,0x6C,0x3E,0x0D,0x0A,0x3C,0x68,0x74,0x6D,0x6C,
    0x3E,0x0D,0x0A,0x09,0x3C,0x68,0x65,0x61,0x64,0x3E,0x0D,
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    0x74,0x6D,0x6C,0x3E,0x0D,0x0A,0x0D,0x0A,0x0D,0x0A,
};

static unsigned char PROGMEM data_Logo_png[3134]=
{
    0x89,0x50,0x4E,0x47,0x0D,0x0A,0x1A,0x0A,0x00,0x00,0x00,
    0x0D,0x49,0x48,0x44,0x52,0x00,0x00,0x00,0x80,0x00,0x00,
    0x00,0x86,0x08,0x00,0x00,0x00,0x00,0x30,0x0C,0xDD,0x0A,
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    0x00,0x00,0x49,0x45,0x4E,0x44,0xAE,0x42,0x60,0x82,
};

// Pin setting for arduino...
unsigned char WLAN_CS = 4;
unsigned char WLAN_EN = 7;
unsigned char WLAN_IRQ = 2;
unsigned char WLAN_IRQ_INTNUM = 0;


#define INDICATE_LED        13

#define RELAY_PIN           A0

#define SMART_CONFIG_PIN    8

unsigned char Relay_Status = 0;

// Don't forget set correct WiFi SSID and Password.
char AP_Ssid[] = {"..."};
char AP_Pass[] = {"..."};

void Initial_Spider(void){
    int ret = 0;
    unsigned long init_timer = 0;

    while(1){
            /* Initial Spider L3 spi interface*/
        Serial.print(F("Starting Spider L3..."));

        Spider_begin();

        Serial.println(F("ok"));

        // Spider L3 SPI interface initial success, indicated LED signal.
        digitalWrite(INDICATE_LED, HIGH); 
        delay(100);
        digitalWrite(INDICATE_LED, LOW);

        /* Connect to WiFi AP */
        Serial.print(F("Connect to "));
        Serial.write((unsigned char*)AP_Ssid, strlen(AP_Ssid));
        Serial.print(F(" access point..."));

        Spider_Connect(3, (char*)AP_Ssid, (char*)AP_Pass);

        Serial.println(F("ok"));
        digitalWrite(INDICATE_LED, HIGH); 
        delay(100);
        digitalWrite(INDICATE_LED, LOW);

        Serial.print(F("Waiting DHCP..."));

        init_timer = millis() + 20000;
        while(init_timer > millis()){
            /* wait connection and Get DHCP address finished */
            if((Spider_CheckDHCP() == 0) && (Spider_CheckConnected() == 0)) break;
        }
        
        if((Spider_CheckDHCP() == 0) && (Spider_CheckConnected() == 0)){
            Serial.println(F("ok"));
            break;
        }
        else{
            Serial.println(F("Timeout."));
        }

        Spider_close();
        delay(1000);
    }

    // Spider L3 connect success, indicated LED signal.
    digitalWrite(INDICATE_LED, HIGH); 
    delay(100);
    digitalWrite(INDICATE_LED, LOW);

    /* show system IP address */
    tNetappIpconfigRetArgs inf;
    netapp_ipconfig(&inf);

    Serial.print(F("Device's IP address:"));
    Serial.print(inf.aucIP[3] ,DEC);
    Serial.print(F("."));
    Serial.print(inf.aucIP[2] ,DEC);
    Serial.print(F("."));
    Serial.print(inf.aucIP[1] ,DEC);
    Serial.print(F("."));
    Serial.print(inf.aucIP[0] ,DEC);
    Serial.print(F("\r\n"));
}

void setup() {          
    /* initial uart debug output interface. */
    Serial.begin(115200);
    //while(!Serial){}

    Serial.println(F("=+=+=+=+=+=+=+=+=+=+=+=+=+=+=+=+=+=+=+=+"));
    Serial.println(F("        Spider L3 Practice 4 AJAX       "));
    Serial.println(F("=+=+=+=+=+=+=+=+=+=+=+=+=+=+=+=+=+=+=+=+"));

    /* initial status LED pin */
    pinMode(INDICATE_LED, OUTPUT);
    digitalWrite(INDICATE_LED, LOW);

    // Initial Relay pin
    digitalWrite(RELAY_PIN, HIGH);
    pinMode(RELAY_PIN, OUTPUT);

    Relay_Status = LOW;

}

int http_server_socket = -1;

#define WAIT_CONNECT            0x02
#define CLOSE_CLIENT_CONN       0x05
unsigned char sw_app_st = WAIT_CONNECT;

int Init_SwitchServer(void){
    sw_app_st = WAIT_CONNECT;
    http_server_socket = -1;
    http_server_socket = WebServer_begin(80);
    if(http_server_socket >= 0) return 0;
    return -1;
}

int Switch_WebService(void){
    static unsigned long task_timer;

    int ret_st = 0;
    static int client_socket = -1;

    char method[7];
    char file[30];
    char content[100];
    char auth;

    unsigned long i;
    unsigned long j;

    if(millis() > task_timer){
        switch(sw_app_st){
            case WAIT_CONNECT:
            client_socket = -1;
            client_socket = WebServer_wait_connect(http_server_socket);
            if(client_socket < 0){
                task_timer = millis() + 250;
                return 0;
            }

            Serial.println(F("Incomming connection from client, Get client message."));
            memset(file, 0, sizeof(file));
            memset(content, 0, sizeof(content));
            memset(method, 0, sizeof(method));
            ret_st = WebServer_process_request(client_socket, method, sizeof(method), 
                                               file, sizeof(file), content, sizeof(content), &auth, 0);
            if(ret_st < 0){
                task_timer = millis() + 250;
                return -1;
            }

            Serial.println("Method:");
            Serial.write((unsigned char*)method, strlen(method));
            Serial.println("");
            Serial.println("File:");
            Serial.write((unsigned char*)file, strlen(file));
            Serial.println("");
            Serial.println("Content:");
            Serial.write((unsigned char*)content, strlen(content));
            Serial.println("");

            // Check Get method.
            if(strstr_P(method, PSTR("GET")) != 0){

                // Check CGI parameter.
                if(strstr_P(file, PSTR("?")) == 0){

                    // Get files.
                    // If chrome send favicon request....
                    if((strstr_P(file, PSTR("logo")) != 0) || (strstr_P(file, PSTR("favicon")) != 0)){
                        
                        memset(content, 0, sizeof(content));
                        strncpy_P(content, PSTR("HTTP/1.1 200 OK\r\n"), sizeof(content));
                        ret_st = WebServer_put_response(client_socket, content, strlen(content));
                        if(ret_st < 0) return -1;

                        memset(content, 0, sizeof(content));
                        strncpy_P(content, PSTR("Content-type: image/png\r\n"), sizeof(content));
                        ret_st = WebServer_put_response(client_socket, content, strlen(content));
                        if(ret_st < 0) return -1;

                        memset(content, 0, sizeof(content));
                        strncpy_P(content, PSTR("Connection: close\r\n\r\n"), sizeof(content));
                        ret_st = WebServer_put_response(client_socket, content, strlen(content));
                        if(ret_st < 0) return -1;

                        i = 0;
                        j = sizeof(data_Logo_png);

                        while(1){
                            
                            if(j > i){
                                if(j > (i + sizeof(content))){
                                    memcpy_P(content, &data_Logo_png[i], sizeof(content));
                                    ret_st = WebServer_put_response(client_socket, content, sizeof(content));
                                    if(ret_st < 0) return -1;
                                    i += sizeof(content);
                                }
                                else{
                                    memcpy_P(content, &data_Logo_png[i], (j - i));
                                    ret_st = WebServer_put_response(client_socket, content, (j - i));
                                    if(ret_st < 0) return -1;
                                    i += sizeof(content);
                                }
                            }
                            else{
                                break;
                            }
                        }
                    }

                    // If send Index.html request.
                    if((strstr_P(file, PSTR("/")) != 0) || (strstr_P(file, PSTR("index.html")) != 0)){
                        
                        memset(content, 0, sizeof(content));
                        strncpy_P(content, PSTR("HTTP/1.1 200 OK\r\n"), sizeof(content));
                        ret_st = WebServer_put_response(client_socket, content, strlen(content));
                        if(ret_st < 0) return -1;

                        memset(content, 0, sizeof(content));
                        strncpy_P(content, PSTR("Content-Type: text/html\r\n"), sizeof(content));
                        ret_st = WebServer_put_response(client_socket, content, strlen(content));
                        if(ret_st < 0) return -1;

                        memset(content, 0, sizeof(content));
                        strncpy_P(content, PSTR("Connection: close\r\n\r\n"), sizeof(content));
                        ret_st = WebServer_put_response(client_socket, content, strlen(content));
                        if(ret_st < 0) return -1;

                        i = 0;
                        j = sizeof(index_data);

                        while(1){
                            
                            if(j > i){
                                if(j > (i + sizeof(content))){
                                    memcpy_P(content, &index_data[i], sizeof(content));
                                    ret_st = WebServer_put_response(client_socket, content, sizeof(content));
                                    if(ret_st < 0) return -1;
                                    i += sizeof(content);
                                }
                                else{
                                    memcpy_P(content, &index_data[i], (j - i));
                                    ret_st = WebServer_put_response(client_socket, content, (j - i));
                                    if(ret_st < 0) return -1;
                                    i += sizeof(content);
                                }
                            }
                            else{
                                break;
                            }
                        }
                    }
                }
                else{
                    // Get with CGI parameter
                }
            }

            // Check POST method.
            if(strstr_P(method, PSTR("POST")) != 0){

                memset(content, 0, sizeof(content));
                strncpy_P(content, PSTR("HTTP/1.1 200 OK\r\n"), sizeof(content));
                ret_st = WebServer_put_response(client_socket, content, strlen(content));
                if(ret_st < 0) return -1;

                memset(content, 0, sizeof(content));
                strncpy_P(content, PSTR("Content-Type: text/html\r\n"), sizeof(content));
                ret_st = WebServer_put_response(client_socket, content, strlen(content));
                if(ret_st < 0) return -1;

                memset(content, 0, sizeof(content));
                strncpy_P(content, PSTR("Connection: close\r\n\r\n"), sizeof(content));
                ret_st = WebServer_put_response(client_socket, content, strlen(content));
                if(ret_st < 0) return -1;

                if(strstr_P(file, PSTR("?SW=ON")) != 0){
                    Relay_Status = HIGH;
                    memset(content, 0, sizeof(content));
                    snprintf(content, sizeof(content), "Switch ON");
                    ret_st = WebServer_put_response(client_socket, content, strlen(content));
                    if(ret_st < 0) return -1;
                }

                if(strstr_P(file, PSTR("?SW=OFF")) != 0){
                    Relay_Status = LOW;
                    memset(content, 0, sizeof(content));
                    snprintf(content, sizeof(content), "Switch OFF");
                    ret_st = WebServer_put_response(client_socket, content, strlen(content));
                    if(ret_st < 0) return -1;
                }

                if(strstr_P(file, PSTR("?Onload")) != 0){
                    memset(content, 0, sizeof(content));
                    if(Relay_Status == HIGH){
                        snprintf(content, sizeof(content), "Switch ON");
                    }
                    else if(Relay_Status == LOW){
                        snprintf(content, sizeof(content), "Switch OFF");
                    }
                    ret_st = WebServer_put_response(client_socket, content, strlen(content));
                    if(ret_st < 0) return -1;
                }
            }

            task_timer = millis() + 250;
            sw_app_st = CLOSE_CLIENT_CONN;
            break;

            case CLOSE_CLIENT_CONN:
                ret_st = WebServer_close_connect(client_socket);
                if(ret_st < 0) return -1;
                client_socket = -1;
                sw_app_st = WAIT_CONNECT;
            break;
        }
    }
    return 0;
}
#if 0
void Find_Me(void){
    /* Timer register */
    static unsigned long tmr = 0;

    /* Simple mdnsAdvisor function */
    char mdns_msg[10];
    memset(mdns_msg, 0, sizeof(mdns_msg));

    if(millis() > tmr){
        strncpy_P(mdns_msg, PSTR("WiFiSW"), sizeof(mdns_msg));
        mdnsAdvertiser(1, (char*)mdns_msg, strlen(mdns_msg));
        tmr = millis() + 30000;
    }
}
#endif
#define WIFI_INIT           1
#define WIFI_PROC           2
#define WIFI_FAIL           3
unsigned char WiFi_Status = WIFI_INIT;

void WiFi_Process(void){
    int ret_st = 0;
    unsigned long temp = 0;
    switch(WiFi_Status){
        case WIFI_INIT:
            //Serial.println("Initial WiFi");
            Initial_Spider();
            delay(1000);

            // ARP initial for 1.13 patch.
            gethostbyname("localhost", strlen("localhost"), &temp);
            gethostbyname("localhost", strlen("localhost"), &temp);
            delay(1000);

            // Fix UDP sendto issue for 1.13 patch.
            long sock;
            sockaddr addr;

            memset(&addr, 0, sizeof(addr));
            sock = socket(AF_INET, SOCK_DGRAM, IPPROTO_UDP);
            // Setting BSD like socket setting.
            addr.sa_family = AF_INET;
            addr.sa_data[0] = 0;
            addr.sa_data[1] = 0;

            addr.sa_data[2] = 127;
            addr.sa_data[3] = 0;
            addr.sa_data[4] = 0;
            addr.sa_data[5] = 1;
            sendto(sock, &temp, sizeof(temp), 0, &addr, sizeof(sockaddr));
            delay(1000);

            // Initial network apps
            if(Init_SwitchServer() == 0){
                WiFi_Status = WIFI_PROC;
            }
            else{
                WiFi_Status = WIFI_FAIL;
            }
        break;
        case WIFI_PROC:

            //Find_Me();

            ret_st = Switch_WebService();
            if(ret_st < 0){
                WiFi_Status = WIFI_FAIL;
                break;
            }
        break;
        case WIFI_FAIL:
            //Serial.println("Close WiFi");
            Spider_close();
            delay(1000);
            WiFi_Status = WIFI_INIT;
        break;
    }
}

void loop() {
    WiFi_Process();
    // Relay is low active
    if(Relay_Status == LOW){
        digitalWrite(RELAY_PIN, HIGH);
    }
    else{
        digitalWrite(RELAY_PIN, LOW);
    }
}